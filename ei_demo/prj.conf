## CMakeLists.txt
```
# Copyright 2020-2025 AVSystem <avsystem@avsystem.com>
#
# Licensed under the Apache License, Version 2.0 (the "License");
# you may not use this file except in compliance with the License.
# You may obtain a copy of the License at
#
#     http://www.apache.org/licenses/LICENSE-2.0
#
# Unless required by applicable law or agreed to in writing, software
# distributed under the License is distributed on an "AS IS" BASIS,
# WITHOUT WARRANTIES OR CONDITIONS OF ANY KIND, either express or implied.
# See the License for the specific language governing permissions and
# limitations under the License.

cmake_minimum_required(VERSION 3.13.1)

# Edge Impulse
set(CMAKE_CXX_STANDARD 11)
set(CMAKE_CXX_STANDARD_REQUIRED ON)
# EI API key has to be set in order to download the TinyML model from EI.
# set(EI_API_KEY_HEADER "x-api-key:ei_XXXXXXXXXXXXXXXXXXXXXXXXXXXXXXXXXXXXXXXXXXXXXXXX")

# Anjay zephyr client
find_package(Zephyr REQUIRED HINTS $ENV{ZEPHYR_BASE})
project(anjay_zephyr_demo)
set(root_dir ${ANJAY_ZEPHYR_CLIENT_DIR})

# Anjay zephyr client
set(app_common_sources
    src/main.c
    src/led.c
    src/led.h
    src/objects/objects.h
    src/objects/pattern_detector.c)

target_sources(app PRIVATE ${app_common_sources})
```

## Kconfig
```
menu "anjay-zephyr-client"

config ANJAY_CLIENT_DEVICE_MANUFACTURER
	string "Device manufacturer"
	default "Unknown"

config ANJAY_CLIENT_MODEL_NUMBER
	string "Model number"
	default "Unknown"

config ANJAY_CLIENT_ENDPOINT_NAME
	string "Endpoint Name"
	default "Anjay-zephyr-client"

config ANJAY_CLIENT_VERSION
	string "Client Version"
	default "22.12"

config ANJAY_CLIENT_SERVER_URI
	string "Server URI"
	default "coaps://eu.iot.avsystem.cloud:5684"

config ANJAY_CLIENT_PSK_IDENTITY
	string "PSK Identity"
	default ANJAY_CLIENT_ENDPOINT_NAME

config ANJAY_CLIENT_PSK_KEY
	string "PSK Key"
	default "test"

config ANJAY_CLIENT_NTP_SERVER
	string "NTP Server"
	default "time.nist.gov"

endmenu

source "Kconfig.zephyr"
```

## west.yml
```
# Copyright 2020-2021 AVSystem <avsystem@avsystem.com>
#
# Licensed under the Apache License, Version 2.0 (the "License");
# you may not use this file except in compliance with the License.
# You may obtain a copy of the License at
#
#     http://www.apache.org/licenses/LICENSE-2.0
#
# Unless required by applicable law or agreed to in writing, software
# distributed under the License is distributed on an "AS IS" BASIS,
# WITHOUT WARRANTIES OR CONDITIONS OF ANY KIND, either express or implied.
# See the License for the specific language governing permissions and
# limitations under the License.

# Manifest for zephyr based samples
manifest:
  remotes:
    - name: anjay
      url-base: https://github.com/AVSystem
    - name: zephyrproject-rtos
      url-base: https://github.com/zephyrproject-rtos
  projects:
    - name: zephyr
      path: zephyr
      remote: zephyrproject-rtos
      revision: v2.6.0
      import: true
    - name: Anjay-zephyr
      submodules: true
      remote: anjay
      revision: 2.14.0
      path: modules/lib/anjay
  self:
    path: Anjay-zephyr-client
```

## prj.conf
```kconfig
# Anjay Settings
CONFIG_ANJAY=y
CONFIG_ANJAY_COMPAT_NET=y
CONFIG_ANJAY_WITH_BOOTSTRAP=n

# General settings
CONFIG_NEWLIB_LIBC=y
CONFIG_NEWLIB_LIBC_FLOAT_PRINTF=y
CONFIG_REBOOT=y
CONFIG_FPU=y
CONFIG_HWINFO=y
CONFIG_SNTP=y
CONFIG_SETTINGS=y

# Generic networking options
CONFIG_NETWORKING=y
CONFIG_NET_UDP=y
CONFIG_NET_IPV4=y
CONFIG_NET_SOCKETS=y
CONFIG_POSIX_MAX_FDS=6
CONFIG_NET_CONNECTION_MANAGER=y

# Logging
CONFIG_NET_LOG=y
CONFIG_LOG=y
CONFIG_PRINTK=y
CONFIG_SHELL=y

# C++ support
CONFIG_CPLUSPLUS=y
CONFIG_LIB_CPLUSPLUS=y
CONFIG_NEWLIB_LIBC_FLOAT_PRINTF=y

# Enable Edge Impulse dependencies
CONFIG_CPLUSPLUS=y
CONFIG_STD_CPP11=y
CONFIG_LIB_CPLUSPLUS=y
CONFIG_NEWLIB_LIBC=y
CONFIG_NEWLIB_LIBC_FLOAT_PRINTF=y
CONFIG_FP16=n

# Enable Edge Impulse
CONFIG_EDGE_IMPULSE=y
# TinyML model can be downloaded from the EI or be provided as a .zip file.
# CONFIG_EDGE_IMPULSE_URI="http://studio.edgeimpulse.com/v1/api/XXXXX/deployment/download?type=zip"
CONFIG_EDGE_IMPULSE_URI="ei_model.zip"
CONFIG_EI_WRAPPER=y
```

## boards/thingy91_nrf9160_ns.conf
```kconfig
# anjay-zephyr-client
CONFIG_ANJAY_ZEPHYR_DEVICE_MANUFACTURER="Nordic Semiconductor"
CONFIG_ANJAY_ZEPHYR_MODEL_NUMBER="Thingy:91"

# Anjay Settings
CONFIG_ANJAY_COMPAT_TIME=y
CONFIG_ANJAY_COMPAT_ZEPHYR_TLS=y
CONFIG_ANJAY_WITH_MICRO_LOGS=y
CONFIG_LOG_MODE_IMMEDIATE=y

# General settings
CONFIG_MAIN_STACK_SIZE=32768
CONFIG_SYSTEM_WORKQUEUE_STACK_SIZE=16384

# Networking
CONFIG_NET_IF_MAX_IPV4_COUNT=2
CONFIG_NET_TCP_ISN_RFC6528=n

# nRF LTE
CONFIG_NRF_MODEM_LIB=y
CONFIG_MODEM_INFO=y
CONFIG_LTE_LINK_CONTROL=y
CONFIG_LTE_NETWORK_TIMEOUT=600

# Clock synchronization
CONFIG_DATE_TIME=y
CONFIG_DATE_TIME_UPDATE_INTERVAL_SECONDS=600
CONFIG_DATE_TIME_TOO_OLD_SECONDS=600
CONFIG_DATE_TIME_MODEM=n
CONFIG_DATE_TIME_NTP_QUERY_TIME_SECONDS=5

# File system
CONFIG_FLASH_PAGE_LAYOUT=y
CONFIG_MPU_ALLOW_FLASH_WRITE=y

# Heap
CONFIG_HEAP_MEM_POOL_SIZE=2048

# Shell settings
CONFIG_SHELL_MINIMAL=y
CONFIG_SHELL_TAB=y
CONFIG_SHELL_TAB_AUTOCOMPLETION=y
CONFIG_DATE_SHELL=n
CONFIG_DEVICE_SHELL=n
CONFIG_DEVMEM_SHELL=n
CONFIG_KERNEL_SHELL=y

# Peripherals
CONFIG_SENSOR=y
CONFIG_ADXL362=y
CONFIG_REGULATOR=y
CONFIG_GPIO=y
CONFIG_ADP536X=y
```

## boards/thingy91_nrf9160ns.conf
```kconfig
# anjay-zephyr-client
CONFIG_ANJAY_CLIENT_DEVICE_MANUFACTURER="Nordic Semiconductor"
CONFIG_ANJAY_CLIENT_MODEL_NUMBER="Thingy:91"

# Anjay Settings
CONFIG_ANJAY_COMPAT_TIME=y
CONFIG_LOG_MODE_IMMEDIATE=y

# General settings
CONFIG_MAIN_STACK_SIZE=32768
CONFIG_SYSTEM_WORKQUEUE_STACK_SIZE=16384

# Networking
CONFIG_NET_IF_MAX_IPV4_COUNT=2

# nRF LTE
CONFIG_NRF_MODEM_LIB=y
CONFIG_LTE_LINK_CONTROL=y
CONFIG_LTE_AUTO_INIT_AND_CONNECT=n
CONFIG_LTE_NETWORK_TIMEOUT=600

# Clock synchronization
CONFIG_DATE_TIME=y
CONFIG_DATE_TIME_UPDATE_INTERVAL_SECONDS=600
CONFIG_DATE_TIME_NTP_QUERY_TIME_SECONDS=5

# File system
CONFIG_FLASH_PAGE_LAYOUT=y
CONFIG_MPU_ALLOW_FLASH_WRITE=y

# Heap
CONFIG_HEAP_MEM_POOL_SIZE=2048

# Peripherals
CONFIG_SENSOR=y
CONFIG_ADXL362=y
```

## src/main.c
```c
/*
 * Copyright 2020-2025 AVSystem <avsystem@avsystem.com>
 *
 * Licensed under the Apache License, Version 2.0 (the "License");
 * you may not use this file except in compliance with the License.
 * You may obtain a copy of the License at
 *
 *     http://www.apache.org/licenses/LICENSE-2.0
 *
 * Unless required by applicable law or agreed to in writing, software
 * distributed under the License is distributed on an "AS IS" BASIS,
 * WITHOUT WARRANTIES OR CONDITIONS OF ANY KIND, either express or implied.
 * See the License for the specific language governing permissions and
 * limitations under the License.
 */

#include <stdlib.h>

#include <anjay_zephyr/config.h>
#include <anjay_zephyr/lwm2m.h>
#include <anjay_zephyr/objects.h>

#include "objects/objects.h"
#include "led.h"

static const anjay_dm_object_def_t **pattern_detector_obj;

static avs_sched_handle_t update_objects_handle;

static int register_objects(anjay_t *anjay)
{
	pattern_detector_obj = pattern_detector_object_create();
	if (pattern_detector_obj) {
		anjay_register_object(anjay, pattern_detector_obj);
	}

	return 0;
}

static void update_objects(avs_sched_t *sched, const void *anjay_ptr)
{
	anjay_t *anjay = *(anjay_t *const *)anjay_ptr;

	pattern_detector_object_update(anjay, pattern_detector_obj);

	AVS_SCHED_DELAYED(sched, &update_objects_handle,
			  avs_time_duration_from_scalar(1, AVS_TIME_S), update_objects, &anjay,
			  sizeof(anjay));
}

static int release_objects(void)
{
	pattern_detector_object_release(pattern_detector_obj);

	return 0;
}

static int init_update_objects(anjay_t *anjay)
{
	avs_sched_t *sched = anjay_get_scheduler(anjay);

	update_objects(sched, &anjay);

	return 0;
}

static int clean_before_anjay_destroy(anjay_t *anjay)
{
	avs_sched_del(&update_objects_handle);

	return 0;
}

int lwm2m_callback(anjay_t *anjay, enum anjay_zephyr_lwm2m_callback_reasons reason)
{
	switch (reason) {
	case ANJAY_ZEPHYR_LWM2M_CALLBACK_REASON_INIT:
		return register_objects(anjay);
	case ANJAY_ZEPHYR_LWM2M_CALLBACK_REASON_ANJAY_READY:
		return init_update_objects(anjay);
	case ANJAY_ZEPHYR_LWM2M_CALLBACK_REASON_ANJAY_SHUTTING_DOWN:
		return clean_before_anjay_destroy(anjay);
	case ANJAY_ZEPHYR_LWM2M_CALLBACK_REASON_CLEANUP:
		return release_objects();
	default:
		return -1;
	}
}

int main(void)
{
	led_init();

	anjay_zephyr_lwm2m_set_user_callback(lwm2m_callback);

	anjay_zephyr_lwm2m_init_from_settings();
	anjay_zephyr_lwm2m_start();

	// Anjay runs in a separate thread and preceding function doesn't block
	// add your own code here
	return 0;
}
```

## src/inference.cpp
```c
/*
 * Copyright 2020-2021 AVSystem <avsystem@avsystem.com>
 *
 * Licensed under the Apache License, Version 2.0 (the "License");
 * you may not use this file except in compliance with the License.
 * You may obtain a copy of the License at
 *
 *     http://www.apache.org/licenses/LICENSE-2.0
 *
 * Unless required by applicable law or agreed to in writing, software
 * distributed under the License is distributed on an "AS IS" BASIS,
 * WITHOUT WARRANTIES OR CONDITIONS OF ANY KIND, either express or implied.
 * See the License for the specific language governing permissions and
 * limitations under the License.
 */

#include <algorithm>
#include <array>

#include <logging/log.h>

#include "inference.h"
#include <edge-impulse-sdk/classifier/ei_run_classifier.h>

LOG_MODULE_REGISTER(inference);

#define ML_DELTA_TRIGGER 0.2f

const size_t ML_SAMPLE_COUNT = EI_CLASSIFIER_RAW_SAMPLE_COUNT;
const size_t ML_SAMPLES_PER_FRAME = EI_CLASSIFIER_RAW_SAMPLES_PER_FRAME;
const size_t ML_SAMPLING_INTERVAL_MS = EI_CLASSIFIER_INTERVAL_MS;
const size_t ML_LABEL_COUNT = EI_CLASSIFIER_LABEL_COUNT;
const char **ML_LABELS = ei_classifier_inferencing_categories;

/**
 * Returns index of the largest element in \c arr if it's
 * at least \c threshold larger than all other elements.
 *
 * @param arr array to search for the dominant index
 * @param n size of the array
 * @param threshold minimum delta of largest and second largest element
 * @returns index of the element matching the requirements, \c -1 otherwise
 */
template <typename T>
static int dominant_index(const T *arr, size_t n, T threshold) {
    if (n == 0) {
        return -1;
    }
    if (n == 1) {
        return 0;
    }

    size_t largest;
    size_t second_largest;
    if (arr[0] >= arr[1]) {
        largest = 0;
        second_largest = 1;
    } else {
        largest = 1;
        second_largest = 0;
    }

    for (size_t i = 2; i < n; i++) {
        if (arr[i] > arr[largest]) {
            second_largest = largest;
            largest = i;
        } else if (arr[i] > arr[second_largest]) {
            second_largest = i;
        }
    }

    return arr[largest] - arr[second_largest] >= threshold ? largest : -1;
}

int run_ml_inference(float *inference_data) {
    signal_t signal;
    numpy::signal_from_buffer(inference_data,
                              EI_CLASSIFIER_DSP_INPUT_FRAME_SIZE, &signal);

    ei_impulse_result_t res;
    EI_IMPULSE_ERROR err = run_classifier(&signal, &res);
    if (err < 0) {
        LOG_ERR("run_classifier returned %d", err);
        return -1;
    }

    float class_values[EI_CLASSIFIER_LABEL_COUNT];
    for (size_t i = 0; i < EI_CLASSIFIER_LABEL_COUNT; i++) {
        class_values[i] = res.classification[i].value;
    }

    return dominant_index(class_values, EI_CLASSIFIER_LABEL_COUNT,
                          ML_DELTA_TRIGGER);
}
```

## src/inference.h
```c
/*
 * Copyright 2020-2021 AVSystem <avsystem@avsystem.com>
 *
 * Licensed under the Apache License, Version 2.0 (the "License");
 * you may not use this file except in compliance with the License.
 * You may obtain a copy of the License at
 *
 *     http://www.apache.org/licenses/LICENSE-2.0
 *
 * Unless required by applicable law or agreed to in writing, software
 * distributed under the License is distributed on an "AS IS" BASIS,
 * WITHOUT WARRANTIES OR CONDITIONS OF ANY KIND, either express or implied.
 * See the License for the specific language governing permissions and
 * limitations under the License.
 */

#pragma once

#include <stddef.h>

#ifdef __cplusplus
extern "C" {
#endif // __cplusplus

extern const size_t ML_SAMPLE_COUNT;
extern const size_t ML_SAMPLES_PER_FRAME;
extern const size_t ML_SAMPLING_INTERVAL_MS;
extern const size_t ML_LABEL_COUNT;
extern const char **ML_LABELS;

/**
 * Run inference of \c data.
 * @param data array of data to run inference on, of size \c ML_SAMPLE_COUNT *
 * \c ML_SAMPLES_PER_FRAME
 * @return \c -1 on no dominant label or error, label ID otherwise
 */
int run_ml_inference(float *inference_data);

#ifdef __cplusplus
}
#endif // __cplusplus
```

## src/led.c
```c
/*
 * Copyright 2020-2025 AVSystem <avsystem@avsystem.com>
 *
 * Licensed under the Apache License, Version 2.0 (the "License");
 * you may not use this file except in compliance with the License.
 * You may obtain a copy of the License at
 *
 *     http://www.apache.org/licenses/LICENSE-2.0
 *
 * Unless required by applicable law or agreed to in writing, software
 * distributed under the License is distributed on an "AS IS" BASIS,
 * WITHOUT WARRANTIES OR CONDITIONS OF ANY KIND, either express or implied.
 * See the License for the specific language governing permissions and
 * limitations under the License.
 */

#include <stdbool.h>

#include <zephyr/drivers/gpio.h>

#include "led.h"

void led_init(void)
{
	if (device_is_ready(LED_DEV(0))) {
		gpio_pin_configure(LED_DEV(0), LED_PIN(0), LED_FLAGS(0));
	}
	if (device_is_ready(LED_DEV(1))) {
		gpio_pin_configure(LED_DEV(1), LED_PIN(1), LED_FLAGS(1));
	}
	if (device_is_ready(LED_DEV(2))) {
		gpio_pin_configure(LED_DEV(2), LED_PIN(2), LED_FLAGS(2));
	}
}

static void led_set(int led, bool state)
{
	switch (led) {
	case 0:
		if (device_is_ready(LED_DEV(0))) {
			gpio_pin_set(LED_DEV(0), LED_PIN(0), state);
		}
		break;
	case 1:
		if (device_is_ready(LED_DEV(1))) {
			gpio_pin_set(LED_DEV(1), LED_PIN(1), state);
		}
		break;
	case 2:
		if (device_is_ready(LED_DEV(2))) {
			gpio_pin_set(LED_DEV(2), LED_PIN(2), state);
		}
		break;
	default:
		break;
	}
}

void led_on(int led)
{
	led_set(led, true);
}

void led_off(int led)
{
	led_set(led, false);
}
```

## src/led.h
```c
/*
 * Copyright 2020-2025 AVSystem <avsystem@avsystem.com>
 *
 * Licensed under the Apache License, Version 2.0 (the "License");
 * you may not use this file except in compliance with the License.
 * You may obtain a copy of the License at
 *
 *     http://www.apache.org/licenses/LICENSE-2.0
 *
 * Unless required by applicable law or agreed to in writing, software
 * distributed under the License is distributed on an "AS IS" BASIS,
 * WITHOUT WARRANTIES OR CONDITIONS OF ANY KIND, either express or implied.
 * See the License for the specific language governing permissions and
 * limitations under the License.
 */

#pragma once

#include <stdint.h>

#include <zephyr/device.h>
#include <zephyr/devicetree.h>

#define LED_NODE(n) DT_ALIAS(led##n)
#define LED_AVAILABLE(n) DT_NODE_HAS_STATUS(LED_NODE(n), okay)

#define LED_DEV(n) DEVICE_DT_GET(DT_GPIO_CTLR(LED_NODE(n), gpios))
#define LED_PIN(n) DT_GPIO_PIN(LED_NODE(n), gpios)
#define LED_FLAGS(n) (GPIO_OUTPUT_INACTIVE | DT_GPIO_FLAGS(LED_NODE(n), gpios))

void led_init(void);
void led_on(int led);
void led_off(int led);
```

## src/utils.c
```c
/*
 * Copyright 2020-2022 AVSystem <avsystem@avsystem.com>
 *
 * Licensed under the Apache License, Version 2.0 (the "License");
 * you may not use this file except in compliance with the License.
 * You may obtain a copy of the License at
 *
 *     http://www.apache.org/licenses/LICENSE-2.0
 *
 * Unless required by applicable law or agreed to in writing, software
 * distributed under the License is distributed on an "AS IS" BASIS,
 * WITHOUT WARRANTIES OR CONDITIONS OF ANY KIND, either express or implied.
 * See the License for the specific language governing permissions and
 * limitations under the License.
 */

#include "utils.h"

#include <string.h>

#include <zephyr/drivers/hwinfo.h>

#include <avsystem/commons/avs_utils.h>

int get_device_id(struct device_id *out_id)
{
	memset(out_id->value, 0, sizeof(out_id->value));

	uint8_t id[12];
	ssize_t retval = hwinfo_get_device_id(id, sizeof(id));

	if (retval <= 0) {
		return -1;
	}

	return avs_hexlify(out_id->value, sizeof(out_id->value), NULL, id, (size_t)retval);
}
```

## src/utils.h
```c
/*
 * Copyright 2020-2022 AVSystem <avsystem@avsystem.com>
 *
 * Licensed under the Apache License, Version 2.0 (the "License");
 * you may not use this file except in compliance with the License.
 * You may obtain a copy of the License at
 *
 *     http://www.apache.org/licenses/LICENSE-2.0
 *
 * Unless required by applicable law or agreed to in writing, software
 * distributed under the License is distributed on an "AS IS" BASIS,
 * WITHOUT WARRANTIES OR CONDITIONS OF ANY KIND, either express or implied.
 * See the License for the specific language governing permissions and
 * limitations under the License.
 */

#pragma once

struct device_id {
	// 96 bits as hex + NULL-byte
	char value[25];
};

int get_device_id(struct device_id *out_id);
```
