## bubblemaker/boards/nrf7002dk_nrf5340_cpuapp.conf
```kconfig
# anjay-zephyr-client
CONFIG_ANJAY_ZEPHYR_DEVICE_MANUFACTURER="Nordic Semiconductor"
CONFIG_ANJAY_ZEPHYR_MODEL_NUMBER="nRF7002DK"

# Anjay Settings
CONFIG_ANJAY_COMPAT_MBEDTLS=y
CONFIG_ANJAY_COMPAT_NET=y
CONFIG_ANJAY_COMPAT_TIME=y
CONFIG_ANJAY_LOG_LEVEL_INF=y
CONFIG_ANJAY_WITH_NET_STATS=n
CONFIG_ANJAY_WITH_SENML_JSON=y
CONFIG_ANJAY_WITH_TRACE_LOGS=n
CONFIG_ANJAY_WITH_ACCESS_CONTROL=n

# General Settings
CONFIG_MAIN_STACK_SIZE=2048
CONFIG_SYSTEM_WORKQUEUE_STACK_SIZE=4096
CONFIG_LOG_MAX_LEVEL=3
CONFIG_POSIX_MAX_FDS=16

# Networking
CONFIG_NET_NATIVE=y
CONFIG_NET_DHCPV4=y
CONFIG_DNS_RESOLVER=y

# WiFi
CONFIG_WIFI=y
CONFIG_WIFI_NRF700X=y
CONFIG_WPA_SUPP=y
CONFIG_NET_L2_WIFI_MGMT=y
CONFIG_NET_L2_WIFI_MGMT_LOG_LEVEL_ERR=y
CONFIG_NET_L2_ETHERNET=y

# Clock synchronization
CONFIG_DATE_TIME=y
CONFIG_DATE_TIME_UPDATE_INTERVAL_SECONDS=600
CONFIG_DATE_TIME_TOO_OLD_SECONDS=600
CONFIG_DATE_TIME_NTP_QUERY_TIME_SECONDS=5
CONFIG_DATE_TIME_THREAD_STACK_SIZE=16384

# File system
CONFIG_FLASH_PAGE_LAYOUT=y
CONFIG_MPU_ALLOW_FLASH_WRITE=y

# Heap
CONFIG_HEAP_MEM_POOL_SIZE=200000

# Bubblemaker
CONFIG_SENSOR=y
CONFIG_ADC=y
CONFIG_W1=y

CONFIG_LED_STRIP=y
CONFIG_WS2812_STRIP=y
CONFIG_SPI=y

CONFIG_GPIO=y
```

## bubblemaker/boards/nrf9160dk_nrf9160_ns.conf
```kconfig
# anjay-zephyr-client
CONFIG_ANJAY_ZEPHYR_DEVICE_MANUFACTURER="AVSystem"
CONFIG_ANJAY_ZEPHYR_MODEL_NUMBER="Bubblemaker"
CONFIG_ANJAY_ZEPHYR_GPS=n
CONFIG_ANJAY_ZEPHYR_GPS_NRF_A_GPS=n

CONFIG_ANJAY_ZEPHYR_FOTA=y

# Anjay Settings
CONFIG_ANJAY_COMPAT_ZEPHYR_TLS=y
CONFIG_ANJAY_COMPAT_NET=y
CONFIG_ANJAY_COMPAT_TIME=y
CONFIG_ANJAY_LOG_LEVEL_INF=y
CONFIG_ANJAY_WITH_NET_STATS=n
CONFIG_ANJAY_WITH_SENML_JSON=y
CONFIG_ANJAY_WITH_TRACE_LOGS=n
CONFIG_ANJAY_WITH_ACCESS_CONTROL=n

# General Settings
CONFIG_MAIN_STACK_SIZE=2048
CONFIG_SYSTEM_WORKQUEUE_STACK_SIZE=4096
CONFIG_LOG_RUNTIME_FILTERING=n
CONFIG_LOG_CMDS=n
CONFIG_LOG_MAX_LEVEL=3
CONFIG_HWINFO=n

# Networking
CONFIG_NET_NATIVE=n
CONFIG_NET_IF_MAX_IPV4_COUNT=2
CONFIG_NET_TCP_ISN_RFC6528=n
CONFIG_NET_LOG=n

# nRF LTE
CONFIG_NRF_MODEM_LIB=y
CONFIG_MODEM_INFO=y
CONFIG_LTE_LINK_CONTROL=y
CONFIG_LTE_NETWORK_MODE_LTE_M_GPS=y
CONFIG_LTE_NETWORK_TIMEOUT=600
CONFIG_NRF_CLOUD_GPS_LOG_LEVEL_INF=y

# Clock synchronization
CONFIG_DATE_TIME=y
CONFIG_DATE_TIME_UPDATE_INTERVAL_SECONDS=600
CONFIG_DATE_TIME_TOO_OLD_SECONDS=600
CONFIG_DATE_TIME_NTP_QUERY_TIME_SECONDS=5

# File system
CONFIG_FLASH_PAGE_LAYOUT=y
CONFIG_MPU_ALLOW_FLASH_WRITE=y
CONFIG_STREAM_FLASH=y

# Heap
CONFIG_HEAP_MEM_POOL_SIZE=2048

# MCUboot
CONFIG_BOOTLOADER_MCUBOOT=y
CONFIG_IMG_MANAGER=y
CONFIG_IMG_ERASE_PROGRESSIVELY=y
CONFIG_MCUBOOT_IMGTOOL_SIGN_VERSION="24.11.0"

# Shell settings
CONFIG_SHELL_MINIMAL=y
CONFIG_SHELL_WILDCARD=n
CONFIG_SHELL_VT100_COMMANDS=y
CONFIG_SHELL_VT100_COLORS=n
CONFIG_SHELL_STATS=n
CONFIG_SHELL_CMDS=n
CONFIG_SHELL_TAB=y
CONFIG_SHELL_TAB_AUTOCOMPLETION=y
CONFIG_SHELL_CMDS_RESIZE=n
CONFIG_DEVICE_SHELL=n
CONFIG_DATE_SHELL=n
CONFIG_DEVMEM_SHELL=n
CONFIG_MCUBOOT_SHELL=n
CONFIG_KERNEL_SHELL=y

# Bubblemaker
CONFIG_SENSOR=y
CONFIG_ADC=y
CONFIG_W1=y

CONFIG_LED_STRIP=y
CONFIG_SPI=y

CONFIG_GPIO=y

# External flash
CONFIG_SPI=y
CONFIG_SPI_NOR=y
CONFIG_SPI_NOR_FLASH_LAYOUT_PAGE_SIZE=4096
CONFIG_SPI_NOR_SFDP_DEVICETREE=y
CONFIG_PM_EXTERNAL_FLASH_MCUBOOT_SECONDARY=y
```

## demo/_sysbuild/mcuboot/boards/tmo_dev_edge.conf
```kconfig
CONFIG_SPI=y
CONFIG_SPI_NOR=y
CONFIG_SPI_NOR_FLASH_LAYOUT_PAGE_SIZE=4096
CONFIG_STREAM_FLASH_ERASE=y

CONFIG_BOOT_MAX_IMG_SECTORS=512
```

## demo/boards/disco_l475_iot1.conf
```kconfig
# anjay-zephyr-client
CONFIG_ANJAY_ZEPHYR_DEVICE_MANUFACTURER="STMicroelectronics"
CONFIG_ANJAY_ZEPHYR_MODEL_NUMBER="B-L475E-IOT01A"
CONFIG_ANJAY_ZEPHYR_FOTA=y
CONFIG_ANJAY_ZEPHYR_THREAD_STACK_SIZE=6144

# Networking
CONFIG_ANJAY_COMPAT_MBEDTLS=y
CONFIG_ANJAY_COMPAT_NET=y

# General settings
CONFIG_MAIN_STACK_SIZE=2048
CONFIG_POSIX_API=y
CONFIG_STREAM_FLASH=y

# Networking
CONFIG_WIFI=y
CONFIG_WIFI_LOG_LEVEL_ERR=y
CONFIG_NET_L2_WIFI_MGMT=y
CONFIG_NET_L2_WIFI_MGMT_LOG_LEVEL_ERR=y

# MbedTLS and security
CONFIG_MBEDTLS=y
CONFIG_MBEDTLS_CIPHER_CCM_ENABLED=y
CONFIG_MBEDTLS_DTLS=y
CONFIG_MBEDTLS_ENTROPY_ENABLED=y
CONFIG_MBEDTLS_KEY_EXCHANGE_PSK_ENABLED=y
CONFIG_ENTROPY_DEVICE_RANDOM_GENERATOR=y
CONFIG_ENTROPY_STM32_RNG=y

# Sensors
CONFIG_I2C=y
CONFIG_SENSOR=y
CONFIG_HTS221=y
CONFIG_VL53L0X=y
CONFIG_LPS22HB=y
CONFIG_LSM6DSL=y
CONFIG_LSM6DSL_GYRO_ODR=1
CONFIG_LSM6DSL_ACCEL_ODR=1
CONFIG_LIS3MDL=y

# Clock synchronization
CONFIG_SNTP=y

# Boot options
CONFIG_BOOTLOADER_MCUBOOT=y
# Note: if relative paths are used here, it is treated as
# relative to $WEST_TOPDIR (typically ~/zephyrproject)
CONFIG_MCUBOOT_SIGNATURE_KEY_FILE="bootloader/mcuboot/root-rsa-2048.pem"
CONFIG_MCUBOOT_IMGTOOL_SIGN_VERSION="24.5.0"
```

## demo/boards/nrf7002dk_nrf5340_cpuapp_ns.conf
```kconfig
# anjay-zephyr-client
CONFIG_ANJAY_ZEPHYR_DEVICE_MANUFACTURER="Nordic Semiconductor"
CONFIG_ANJAY_ZEPHYR_MODEL_NUMBER="nRF7002DK"

CONFIG_ANJAY_ZEPHYR_FOTA=y

# Anjay Settings
CONFIG_ANJAY_COMPAT_MBEDTLS=y
CONFIG_ANJAY_COMPAT_NET=y
CONFIG_ANJAY_LOG_LEVEL_INF=y
CONFIG_ANJAY_WITH_NET_STATS=n
CONFIG_ANJAY_WITH_TRACE_LOGS=n
CONFIG_ANJAY_WITH_ACCESS_CONTROL=n

# General Settings
CONFIG_MAIN_STACK_SIZE=2048
CONFIG_SYSTEM_WORKQUEUE_STACK_SIZE=4096
CONFIG_LOG_MAX_LEVEL=3
CONFIG_POSIX_MAX_FDS=16

# Networking
CONFIG_NET_NATIVE=y
CONFIG_NET_DHCPV4=y
CONFIG_DNS_RESOLVER=y
# on nRF7002DK the default (4) is not enough. Besides DNS, DHCP, LwM2M server
# connection and possible connection for FOTA download, there's also an EAPOL
# connection opened by wpa_supplicant.
CONFIG_NET_MAX_CONN=5

# WiFi
CONFIG_WIFI=y
CONFIG_WIFI_NRF700X=y
CONFIG_WPA_SUPP=y
CONFIG_WPA_SUPP_CRYPTO_PSA=y
CONFIG_PSA_WANT_ALG_HMAC=y
CONFIG_NET_L2_WIFI_MGMT=y
CONFIG_NET_L2_WIFI_MGMT_LOG_LEVEL_ERR=y
CONFIG_NET_L2_ETHERNET=y

# Clock synchronization
CONFIG_DATE_TIME=y
CONFIG_DATE_TIME_UPDATE_INTERVAL_SECONDS=600
CONFIG_DATE_TIME_TOO_OLD_SECONDS=600
CONFIG_DATE_TIME_NTP_QUERY_TIME_SECONDS=5

# File system
CONFIG_STREAM_FLASH=y
CONFIG_FLASH_PAGE_LAYOUT=y
CONFIG_MPU_ALLOW_FLASH_WRITE=y

# Heap
CONFIG_COMMON_LIBC_MALLOC_ARENA_SIZE=150000
CONFIG_HEAP_MEM_POOL_SIZE=150000

# MCUboot
CONFIG_BOOTLOADER_MCUBOOT=y
CONFIG_IMG_MANAGER=y
CONFIG_IMG_ERASE_PROGRESSIVELY=y
CONFIG_MCUBOOT_IMGTOOL_SIGN_VERSION="26.9.0"

# External flash
CONFIG_SPI=y
CONFIG_SPI_NOR=y
CONFIG_SPI_NOR_FLASH_LAYOUT_PAGE_SIZE=4096
CONFIG_SPI_NOR_SFDP_DEVICETREE=y
CONFIG_PM_EXTERNAL_FLASH_MCUBOOT_SECONDARY=y

# Network core upgrades collide with app FOTA
CONFIG_NRF53_UPGRADE_NETWORK_CORE=n
```

## demo/boards/thingy91_nrf9160_ns.conf
```kconfig
# anjay-zephyr-client
CONFIG_ANJAY_ZEPHYR_DEVICE_MANUFACTURER="Nordic Semiconductor"
CONFIG_ANJAY_ZEPHYR_MODEL_NUMBER="Thingy:91"
CONFIG_ANJAY_ZEPHYR_GPS=y
CONFIG_ANJAY_ZEPHYR_GPS_NRF_A_GPS=y

CONFIG_ANJAY_ZEPHYR_FOTA=y

# Anjay Settings
CONFIG_ANJAY_COMPAT_ZEPHYR_TLS=y
CONFIG_ANJAY_COMPAT_NET=y
CONFIG_ANJAY_COMPAT_TIME=y
CONFIG_ANJAY_WITH_NET_STATS=n
CONFIG_ANJAY_WITH_SENML_JSON=y
CONFIG_ANJAY_WITH_TRACE_LOGS=n
CONFIG_ANJAY_WITH_ACCESS_CONTROL=n

# I2C Settings
CONFIG_I2C_SHELL=n

# General Settings
CONFIG_MAIN_STACK_SIZE=2048
CONFIG_SYSTEM_WORKQUEUE_STACK_SIZE=4096
CONFIG_INIT_STACKS=n
CONFIG_LOG_RUNTIME_FILTERING=n
CONFIG_LOG_CMDS=n
CONFIG_LOG_MAX_LEVEL=3
CONFIG_HWINFO=n
CONFIG_CBPRINTF_NANO=y

# Networking
CONFIG_NET_NATIVE=n
CONFIG_NET_IF_MAX_IPV4_COUNT=2
CONFIG_NET_TCP_ISN_RFC6528=n
CONFIG_NET_LOG=n

# nRF LTE
CONFIG_NRF_MODEM_LIB=y
CONFIG_MODEM_INFO=y
CONFIG_LTE_LINK_CONTROL=y
CONFIG_LTE_NETWORK_MODE_LTE_M_GPS=y
CONFIG_LTE_AUTO_INIT_AND_CONNECT=n
CONFIG_LTE_NETWORK_TIMEOUT=600

# Clock synchronization
CONFIG_DATE_TIME=y
CONFIG_DATE_TIME_UPDATE_INTERVAL_SECONDS=600
CONFIG_DATE_TIME_TOO_OLD_SECONDS=600
CONFIG_DATE_TIME_MODEM=n
CONFIG_DATE_TIME_NTP_QUERY_TIME_SECONDS=5

# File system
CONFIG_FLASH_PAGE_LAYOUT=y
CONFIG_MPU_ALLOW_FLASH_WRITE=y
CONFIG_STREAM_FLASH=y

# Heap
CONFIG_HEAP_MEM_POOL_SIZE=2048

# Peripherals
CONFIG_I2C=y
CONFIG_PWM=y
CONFIG_SENSOR=y
CONFIG_BME680=y
CONFIG_ADXL362=y
CONFIG_ADXL362_ACCEL_ODR_12_5=y
CONFIG_ADXL362_ACCEL_RANGE_2G=y
CONFIG_REGULATOR=n

# MCUboot
CONFIG_BOOTLOADER_MCUBOOT=y
CONFIG_IMG_MANAGER=y
CONFIG_IMG_ERASE_PROGRESSIVELY=y
CONFIG_MCUBOOT_IMGTOOL_SIGN_VERSION="24.2.0"

# Shell settings
CONFIG_SHELL_MINIMAL=y
CONFIG_SHELL_WILDCARD=n
CONFIG_SHELL_VT100_COMMANDS=y
CONFIG_SHELL_VT100_COLORS=n
CONFIG_SHELL_STATS=n
CONFIG_SHELL_CMDS=n
CONFIG_SHELL_TAB=y
CONFIG_SHELL_TAB_AUTOCOMPLETION=y
CONFIG_SHELL_CMDS_RESIZE=n
CONFIG_DATE_SHELL=n
CONFIG_DEVICE_SHELL=n
CONFIG_DEVMEM_SHELL=n
CONFIG_KERNEL_SHELL=y
CONFIG_LTE_SHELL=n
CONFIG_MCUBOOT_SHELL=n
CONFIG_PWM_SHELL=n
CONFIG_CLOCK_CONTROL_NRF_SHELL=n

# Log level
CONFIG_ANJAY_LOG_LEVEL_INF=y
CONFIG_LTE_LINK_CONTROL_LOG_LEVEL_WRN=y
CONFIG_NRF_CLOUD_GPS_LOG_LEVEL_OFF=y
CONFIG_NRF_CLOUD_LOG_LEVEL_OFF=y
CONFIG_AT_MONITOR_LOG_LEVEL_ERR=y
CONFIG_MODEM_KEY_MGMT_LOG_LEVEL_ERR=y
CONFIG_MODEM_ANTENNA_LOG_LEVEL_ERR=y
CONFIG_ESB_LOG_LEVEL_ERR=y
CONFIG_MPSL_FEM_LOG_LEVEL_ERR=y
CONFIG_MPSL_LOG_LEVEL_ERR=y
CONFIG_MGMT_FMFU_LOG_LEVEL_ERR=y
CONFIG_DATE_TIME_LOG_LEVEL_ERR=y
CONFIG_BOARD_LOG_LEVEL_ERR=y
CONFIG_ARCH_LOG_LEVEL_ERR=y
CONFIG_MPU_LOG_LEVEL_ERR=y
CONFIG_UART_CONSOLE_LOG_LEVEL_ERR=y
CONFIG_UART_LOG_LEVEL_ERR=y
CONFIG_INTC_LOG_LEVEL_ERR=y
CONFIG_ENTROPY_LOG_LEVEL_ERR=y
CONFIG_GPIO_LOG_LEVEL_ERR=y
CONFIG_FXL6408_LOG_LEVEL_ERR=y
CONFIG_SPI_LOG_LEVEL_ERR=y
CONFIG_I2C_LOG_LEVEL_ERR=y
CONFIG_PWM_LOG_LEVEL_ERR=y
CONFIG_CLOCK_CONTROL_LOG_LEVEL_ERR=y
CONFIG_PINCTRL_LOG_LEVEL_ERR=y
CONFIG_USBC_LOG_LEVEL_ERR=y
CONFIG_CBPRINTF_PACKAGE_LOG_LEVEL_ERR=y
CONFIG_NVS_LOG_LEVEL_ERR=y
CONFIG_PM_LOG_LEVEL_ERR=y
CONFIG_SHELL_BACKEND_SERIAL_LOG_LEVEL_ERR=y
CONFIG_IMG_MANAGER_LOG_LEVEL_ERR=y
CONFIG_STREAM_FLASH_LOG_LEVEL_ERR=y
```

## demo/boards/tmo_dev_edge.conf
```kconfig
# anjay-zephyr-client
CONFIG_ANJAY_ZEPHYR_DEVICE_MANUFACTURER="T-Mobile"
CONFIG_ANJAY_ZEPHYR_MODEL_NUMBER="DevEdge"
CONFIG_ANJAY_ZEPHYR_FOTA=y
CONFIG_ANJAY_ZEPHYR_GPS=y

# Anjay Settings
CONFIG_ANJAY_COMPAT_MBEDTLS=y
CONFIG_ANJAY_COMPAT_NET=y
CONFIG_ANJAY_COMPAT_TIME=y

# Allow runtime certificate configuration
CONFIG_ANJAY_ZEPHYR_RUNTIME_CERT_CONFIG=y
CONFIG_MBEDTLS_ECP_DP_SECP384R1_ENABLED=y
CONFIG_MBEDTLS_ECP_DP_SECP256R1_ENABLED=y
CONFIG_MBEDTLS_PEM_CERTIFICATE_FORMAT=y
CONFIG_MBEDTLS_KEY_EXCHANGE_ECDHE_ECDSA_ENABLED=y

# Monitoring
CONFIG_THREAD_ANALYZER=y
CONFIG_THREAD_ANALYZER_USE_LOG=y
CONFIG_THREAD_NAME=y

# MbedTLS and security
CONFIG_MBEDTLS=y
CONFIG_MBEDTLS_ECP_C=y
CONFIG_MBEDTLS_ECDH_C=y
CONFIG_MBEDTLS_ECDSA_C=y
CONFIG_MBEDTLS_DTLS=y
CONFIG_MBEDTLS_KEY_EXCHANGE_PSK_ENABLED=y
CONFIG_MBEDTLS_CIPHER_CCM_ENABLED=y
CONFIG_MBEDTLS_ENTROPY_ENABLED=y

# Hardware Configuration
CONFIG_SOC_GECKO_EMU_DCDC=y
CONFIG_SOC_GECKO_EMU_DCDC_MODE_OFF=y
CONFIG_CMU_HFCLK_HFXO=y

# General settings
CONFIG_MAIN_STACK_SIZE=16384

# Hardware class support
CONFIG_I2C=y
CONFIG_LED=y
CONFIG_LED_PWM=y
CONFIG_PWM=y
CONFIG_SENSOR=y
CONFIG_SPI=y
CONFIG_SPI_NOR=y
CONFIG_SPI_NOR_FLASH_LAYOUT_PAGE_SIZE=4096
CONFIG_STREAM_FLASH_ERASE=y
CONFIG_WIFI=y

# Device Drivers
CONFIG_PWM_GECKO=y
CONFIG_LIS2DW12=y
CONFIG_LPS22HH=y
CONFIG_TMP108=y
CONFIG_TSL2540=y
CONFIG_COUNTER=y
CONFIG_WIFI_RS9116W=y

CONFIG_MODEM=y
CONFIG_MODEM_SHELL=y
CONFIG_MODEM_MURATA_1SC=y
CONFIG_MODEM_MURATA_1SC_APN="iot.t-mobile.com"

# OS Support library
CONFIG_REBOOT=y
CONFIG_POSIX_CLOCK=y

# Logging
CONFIG_LOG_MODE_DEFERRED=y
CONFIG_LOG_BLOCK_IN_THREAD=y

CONFIG_CONSOLE_SUBSYS=y
CONFIG_CONSOLE_GETLINE=y

# Networking
CONFIG_NET_L2_WIFI_MGMT=y
CONFIG_NET_SOCKETS_POSIX_NAMES=y
CONFIG_NET_TCP=y

# Offload TCP/IP stack to a co-processor
CONFIG_RS9116W_TLS_OFFLOAD=y
CONFIG_NET_NATIVE=n
CONFIG_NET_OFFLOAD=y
CONFIG_NET_SOCKETS_OFFLOAD=y

# Clock synchronization
CONFIG_SNTP=y

# FOTA support
CONFIG_STREAM_FLASH=y

# Boot options
CONFIG_BOOTLOADER_MCUBOOT=y
# Note: if relative paths are used here, it is treated as
# relative to $WEST_TOPDIR (typically ~/zephyrproject)
CONFIG_MCUBOOT_SIGNATURE_KEY_FILE="bootloader/mcuboot/root-rsa-2048.pem"
CONFIG_MCUBOOT_EXTRA_IMGTOOL_ARGS="--version 23.11.0"
```

## demo/child_image/mcuboot/boards/nrf7002dk_nrf5340_cpuapp.conf
```kconfig
# This file sets some board-dependent variables in MCUBoot child image.
# Refer to:
# https://developer.nordicsemi.com/nRF_Connect_SDK/doc/2.7.0/nrf/config_and_build/multi_image.html#image-specific-variables

### anjay-zephyr-client
CONFIG_PM_PARTITION_SIZE_MCUBOOT=0x10000
CONFIG_PM_PARTITION_SIZE_MCUBOOT_PAD=0x200
CONFIG_PM_PARTITION_SIZE_MCUBOOT_SCRATCH=0x10000

# External flash config
CONFIG_SPI=y
CONFIG_SPI_NOR=y
CONFIG_SPI_NOR_FLASH_LAYOUT_PAGE_SIZE=4096
CONFIG_SPI_NOR_SFDP_DEVICETREE=y

CONFIG_NRF53_UPGRADE_NETWORK_CORE=n
CONFIG_FLASH_SIMULATOR=n
```

## demo/child_image/mcuboot/boards/nrf9151dk_nrf9151.conf
```kconfig
# This file sets some board-dependent variables in MCUBoot child image.
# Refer to:
# https://developer.nordicsemi.com/nRF_Connect_SDK/doc/2.7.0/nrf/config_and_build/multi_image.html#image-specific-variables

### anjay-zephyr-client
CONFIG_PM_PARTITION_SIZE_MCUBOOT=0x10000
CONFIG_PM_PARTITION_SIZE_MCUBOOT_PAD=0x200
CONFIG_PM_PARTITION_SIZE_MCUBOOT_SCRATCH=0x10000

# External flash config
CONFIG_SPI=y
CONFIG_SPI_NOR=y
CONFIG_SPI_NOR_SFDP_DEVICETREE=y
CONFIG_SPI_NOR_FLASH_LAYOUT_PAGE_SIZE=4096
```

## demo/child_image/mcuboot/boards/nrf9160dk_nrf9160_intflash.conf
```kconfig
# This file sets some board-dependent variables in MCUBoot child image.
# Refer to:
# https://developer.nordicsemi.com/nRF_Connect_SDK/doc/2.5.0/nrf/config_and_build/multi_image.html#image-specific-variables

### Original source
CONFIG_PM=n

CONFIG_MAIN_STACK_SIZE=10240
CONFIG_MBEDTLS_CFG_FILE="mcuboot-mbedtls-cfg.h"

CONFIG_BOOT_SWAP_SAVE_ENCTLV=n

CONFIG_BOOT_UPGRADE_ONLY=n
CONFIG_BOOT_BOOTSTRAP=n

### mbedTLS has its own heap
# CONFIG_HEAP_MEM_POOL_SIZE is not set

### We never want Zephyr's copy of tinycrypt.  If tinycrypt is needed,
### MCUboot has its own copy in tree.
# CONFIG_TINYCRYPT is not set
# CONFIG_TINYCRYPT_ECC_DSA is not set
# CONFIG_TINYCRYPT_SHA256 is not set

CONFIG_FLASH=y
CONFIG_FPROTECT=y

### Various Zephyr boards enable features that we don't want.
# CONFIG_BT is not set
# CONFIG_BT_CTLR is not set
# CONFIG_I2C is not set

CONFIG_LOG=y
CONFIG_LOG_MODE_MINIMAL=y # former CONFIG_MODE_MINIMAL
### Ensure Zephyr logging changes don't use more resources
CONFIG_LOG_DEFAULT_LEVEL=0
### Decrease footprint by ~4 KB in comparison to CBPRINTF_COMPLETE=y
CONFIG_CBPRINTF_NANO=y

### anjay-zephyr-client
CONFIG_BOOT_SWAP_USING_SCRATCH=y
CONFIG_PM_PARTITION_SIZE_MCUBOOT=0x10000
CONFIG_PM_PARTITION_SIZE_MCUBOOT_PAD=0x200
CONFIG_PM_PARTITION_SIZE_MCUBOOT_SCRATCH=0x10000
```

## minimal/boards/nrf9160dk_nrf9160_ns.conf
```kconfig
# Anjay Settings
CONFIG_ANJAY_COMPAT_TIME=y
CONFIG_ANJAY_COMPAT_ZEPHYR_TLS=y

# General Settings
CONFIG_MAIN_STACK_SIZE=32768
CONFIG_SYSTEM_WORKQUEUE_STACK_SIZE=4096

# Networking
CONFIG_NET_IF_MAX_IPV4_COUNT=2
CONFIG_NET_TCP_ISN_RFC6528=n

# nRF LTE
CONFIG_NRF_MODEM_LIB=y
CONFIG_LTE_LINK_CONTROL=y
CONFIG_LTE_AUTO_INIT_AND_CONNECT=n
CONFIG_LTE_NETWORK_TIMEOUT=600

# Logging
CONFIG_LOG_BLOCK_IN_THREAD=y
CONFIG_LOG2_MODE_DEFERRED=y

# Clock synchronization
CONFIG_DATE_TIME=y
CONFIG_DATE_TIME_UPDATE_INTERVAL_SECONDS=600
CONFIG_DATE_TIME_TOO_OLD_SECONDS=600
CONFIG_DATE_TIME_NTP_QUERY_TIME_SECONDS=5

# File system
CONFIG_FLASH_PAGE_LAYOUT=y
CONFIG_MPU_ALLOW_FLASH_WRITE=y

# Heap
CONFIG_HEAP_MEM_POOL_SIZE=2048
```
