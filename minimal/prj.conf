## CMakeLists.txt
```
# Copyright 2020-2025 AVSystem <avsystem@avsystem.com>
#
# Licensed under the Apache License, Version 2.0 (the "License");
# you may not use this file except in compliance with the License.
# You may obtain a copy of the License at
#
#     http://www.apache.org/licenses/LICENSE-2.0
#
# Unless required by applicable law or agreed to in writing, software
# distributed under the License is distributed on an "AS IS" BASIS,
# WITHOUT WARRANTIES OR CONDITIONS OF ANY KIND, either express or implied.
# See the License for the specific language governing permissions and
# limitations under the License.

cmake_minimum_required(VERSION 3.13.1)
find_package(Zephyr REQUIRED HINTS $ENV{ZEPHYR_BASE})
project(anjay_zephyr_demo)
set(root_dir ${ANJAY_ZEPHYR_CLIENT_DIR})

set(app_common_sources
    src/main.c)

target_sources(app PRIVATE
                ${app_common_sources}
                )
```

## Kconfig
```
menu "anjay-zephyr-client"

config ANJAY_CLIENT_DEVICE_MANUFACTURER
	string "Device manufacturer"
	default "Unknown"

config ANJAY_CLIENT_MODEL_NUMBER
	string "Model number"
	default "Unknown"

config ANJAY_CLIENT_ENDPOINT_NAME
	string "Endpoint Name"
	default "Anjay-zephyr-client"

config ANJAY_CLIENT_VERSION
	string "Client Version"
	default "22.12"

config ANJAY_CLIENT_SERVER_URI
	string "Server URI"
	default "coaps://eu.iot.avsystem.cloud:5684"

config ANJAY_CLIENT_PSK_IDENTITY
	string "PSK Identity"
	default ANJAY_CLIENT_ENDPOINT_NAME

config ANJAY_CLIENT_PSK_KEY
	string "PSK Key"
	default "test"

config ANJAY_CLIENT_NTP_SERVER
	string "NTP Server"
	default "time.nist.gov"

if WIFI
	config ANJAY_CLIENT_WIFI_SSID
	    string "Wifi SSID"
	    default "ssid"

	config ANJAY_CLIENT_WIFI_PASSWORD
	    string "Wifi password"
	    default "password"
endif
endmenu

source "Kconfig.zephyr"
```

## west.yml
```
# Copyright 2020-2025 AVSystem <avsystem@avsystem.com>
#
# Licensed under the Apache License, Version 2.0 (the "License");
# you may not use this file except in compliance with the License.
# You may obtain a copy of the License at
#
#     http://www.apache.org/licenses/LICENSE-2.0
#
# Unless required by applicable law or agreed to in writing, software
# distributed under the License is distributed on an "AS IS" BASIS,
# WITHOUT WARRANTIES OR CONDITIONS OF ANY KIND, either express or implied.
# See the License for the specific language governing permissions and
# limitations under the License.

# Manifest for zephyr based samples
manifest:
  remotes:
  - name: anjay
    url-base: https://github.com/AVSystem
  - name: zephyrproject-rtos
    url-base: https://github.com/zephyrproject-rtos
  projects:
  - name: zephyr
    path: zephyr
    remote: zephyrproject-rtos
    revision: v3.6.0
    import: true
  - name: Anjay-zephyr
    submodules: true
    remote: anjay
    revision: 3.9.0
    path: modules/lib/anjay
```

## prj.conf
```kconfig
# Anjay Settings
CONFIG_ANJAY=y
CONFIG_ANJAY_COMPAT_NET=y
CONFIG_ANJAY_WITH_ACCESS_CONTROL=n
CONFIG_ANJAY_WITH_NET_STATS=n
CONFIG_ANJAY_WITH_TRACE_LOGS=n
CONFIG_ANJAY_LOG_LEVEL_INF=y

# Anjay Client Settings
CONFIG_ANJAY_ZEPHYR_FACTORY_PROVISIONING=n

# General settings
CONFIG_REBOOT=y
CONFIG_FPU=y
CONFIG_HWINFO=y
CONFIG_SNTP=y
CONFIG_SHELL=y

# Generic networking options
CONFIG_NETWORKING=y
CONFIG_NET_UDP=y
CONFIG_NET_TCP=n
CONFIG_NET_IPV4=y
CONFIG_NET_IPV6=n
CONFIG_NET_SOCKETS=y
CONFIG_POSIX_MAX_FDS=6
CONFIG_NET_MGMT=y
CONFIG_NET_MGMT_EVENT=y
CONFIG_NET_MGMT_EVENT_INFO=y

# Logging
CONFIG_NET_LOG=y
CONFIG_LOG=y
CONFIG_PRINTK=y

# Storage
CONFIG_FLASH=y
CONFIG_FLASH_MAP=y
CONFIG_NVS=y
CONFIG_SETTINGS=y
CONFIG_FLASH_LOG_LEVEL_ERR=y
```

## boards/arduino_nano_33_ble_sense.conf
```kconfig
# Anjay Settings
CONFIG_ANJAY_COMPAT_TIME=y
CONFIG_ANJAY_COMPAT_MBEDTLS=y

# General Settings
CONFIG_MAIN_STACK_SIZE=2048
CONFIG_SYSTEM_WORKQUEUE_STACK_SIZE=2048

# Logging
CONFIG_LOG_BLOCK_IN_THREAD=y
CONFIG_LOG_MODE_DEFERRED=y

# Clock synchronization
CONFIG_DATE_TIME=y
CONFIG_DATE_TIME_AUTO_UPDATE=n

# Networking
CONFIG_NET_IPV4=n
CONFIG_NET_TCP=n
CONFIG_NET_IPV6=y
CONFIG_NET_IPV6_NBR_CACHE=n
CONFIG_NET_IPV6_MLD=n
CONFIG_NET_CONFIG_NEED_IPV4=n
CONFIG_NET_L2_OPENTHREAD=y

# DNS
CONFIG_DNS_RESOLVER=y
CONFIG_DNS_SERVER_IP_ADDRESSES=y
CONFIG_DNS_SERVER1="fdaa:bb:1::2"

# OpenThread
CONFIG_OPENTHREAD_JOINER=y
CONFIG_OPENTHREAD_JOINER_AUTOSTART=y
CONFIG_OPENTHREAD_MANUAL_START=n
CONFIG_OPENTHREAD_SLAAC=y
CONFIG_OPENTHREAD_JOINER_PSKD="J01NME"
CONFIG_OPENTHREAD_MTD=y

# MbedTLS and security
CONFIG_MBEDTLS_LEGACY_CRYPTO_C=y
CONFIG_MBEDTLS_CTR_DRBG_C=y
CONFIG_MBEDTLS_KEY_EXCHANGE_ECDHE_ECDSA_ENABLED=y
```

## boards/disco_l475_iot1.conf
```kconfig
# Anjay Settings
CONFIG_ANJAY_COMPAT_MBEDTLS=y

# General settings
CONFIG_MAIN_STACK_SIZE=16384
CONFIG_POSIX_API=y

# Networking
CONFIG_WIFI=y
CONFIG_WIFI_LOG_LEVEL_ERR=y
CONFIG_NET_L2_WIFI_MGMT=y
CONFIG_NET_L2_WIFI_MGMT_LOG_LEVEL_ERR=y

# Logging
CONFIG_LOG_BLOCK_IN_THREAD=y
CONFIG_LOG_MODE_DEFERRED=y

# MbedTLS and security
CONFIG_MBEDTLS_CIPHER_CCM_ENABLED=y

# Clock synchronization
CONFIG_SNTP=y
```

## boards/esp32.conf
```kconfig
# anjay-zephyr-client
CONFIG_ANJAY_ZEPHYR_DEVICE_MANUFACTURER="Espressif"
CONFIG_ANJAY_ZEPHYR_MODEL_NUMBER="ESP32-DevKitC"

# Networking
CONFIG_ANJAY_COMPAT_NET=y

CONFIG_NETWORKING=y
CONFIG_POSIX_API=y
CONFIG_NET_L2_WIFI_MGMT=y
CONFIG_NET_MGMT=y
CONFIG_NET_MGMT_EVENT=y
CONFIG_NET_LOG=y
CONFIG_DNS_RESOLVER=y

# MbedTLS and security
CONFIG_ANJAY_COMPAT_MBEDTLS=y
CONFIG_MBEDTLS=y
CONFIG_MBEDTLS_ENTROPY_ENABLED=y
CONFIG_MBEDTLS_KEY_EXCHANGE_ECDHE_ECDSA_ENABLED=y
CONFIG_MBEDTLS_ECP_DP_SECP256R1_ENABLED=y

# Clock synchronization
CONFIG_SNTP=y

# ESP32 Wi-Fi
CONFIG_WIFI=y
CONFIG_WIFI_ESP32=y
CONFIG_HEAP_MEM_POOL_SIZE=98304
CONFIG_NET_L2_ETHERNET=y
CONFIG_NET_DEFAULT_IF_FIRST=y

CONFIG_NET_IPV6=n
CONFIG_NET_IPV4=y
CONFIG_NET_DHCPV4=y

# ESP32 memory optimization
CONFIG_ESP32_WIFI_IRAM_OPT=n
CONFIG_ESP32_WIFI_RX_IRAM_OPT=n
```

## boards/esp32_devkitc_wroom.conf
```kconfig
# anjay-zephyr-client
CONFIG_ANJAY_ZEPHYR_DEVICE_MANUFACTURER="Espressif"
CONFIG_ANJAY_ZEPHYR_MODEL_NUMBER="ESP32-DevKitC"

# Networking
CONFIG_ANJAY_COMPAT_NET=y

CONFIG_NETWORKING=y
CONFIG_POSIX_API=y
CONFIG_NET_L2_WIFI_MGMT=y
CONFIG_NET_LOG=y
CONFIG_DNS_RESOLVER=y

# MbedTLS and security
CONFIG_ANJAY_COMPAT_MBEDTLS=y
CONFIG_MBEDTLS_KEY_EXCHANGE_ECDHE_ECDSA_ENABLED=y
CONFIG_MBEDTLS_ECP_DP_SECP256R1_ENABLED=y

# Clock synchronization
CONFIG_SNTP=y

# ESP32 Wi-Fi
CONFIG_WIFI=y
CONFIG_WIFI_ESP32=y
CONFIG_HEAP_MEM_POOL_SIZE=98304
CONFIG_NET_L2_ETHERNET=y
CONFIG_NET_DEFAULT_IF_FIRST=y

CONFIG_NET_IPV6=n
CONFIG_NET_IPV4=y
CONFIG_NET_DHCPV4=y

# ESP32 memory optimization
CONFIG_ESP32_WIFI_IRAM_OPT=n
CONFIG_ESP32_WIFI_RX_IRAM_OPT=n
```

## boards/nrf52840dk_nrf52840.conf
```kconfig
# Anjay Settings
CONFIG_ANJAY_COMPAT_TIME=y
CONFIG_ANJAY_COMPAT_MBEDTLS=y

# General Settings
CONFIG_MAIN_STACK_SIZE=8192
CONFIG_SYSTEM_WORKQUEUE_STACK_SIZE=2048

# Logging
CONFIG_LOG_BLOCK_IN_THREAD=y
CONFIG_LOG_MODE_DEFERRED=y

# Clock synchronization
CONFIG_DATE_TIME=y
CONFIG_DATE_TIME_AUTO_UPDATE=n

# Networking
CONFIG_NET_IPV4=n
CONFIG_NET_TCP=n
CONFIG_NET_IPV6=y
CONFIG_NET_IPV6_NBR_CACHE=n
CONFIG_NET_IPV6_MLD=n
CONFIG_NET_CONFIG_NEED_IPV4=n
CONFIG_NET_L2_OPENTHREAD=y

# DNS
CONFIG_DNS_RESOLVER=y
CONFIG_DNS_SERVER_IP_ADDRESSES=y
CONFIG_DNS_SERVER1="fdaa:bb:1::2"

# OpenThread
CONFIG_OPENTHREAD_JOINER=y
CONFIG_OPENTHREAD_JOINER_AUTOSTART=y
CONFIG_OPENTHREAD_MANUAL_START=n
CONFIG_OPENTHREAD_SLAAC=y
CONFIG_OPENTHREAD_JOINER_PSKD="J01NME"
CONFIG_OPENTHREAD_MTD=y

# MbedTLS and security
CONFIG_MBEDTLS_LEGACY_CRYPTO_C=y
CONFIG_MBEDTLS_CTR_DRBG_C=y
CONFIG_MBEDTLS_KEY_EXCHANGE_ECDHE_ECDSA_ENABLED=y
```

## boards/nrf7002dk_nrf5340_cpuapp.conf
```kconfig
# anjay-zephyr-client
CONFIG_ANJAY_ZEPHYR_DEVICE_MANUFACTURER="Nordic Semiconductor"
CONFIG_ANJAY_ZEPHYR_MODEL_NUMBER="nRF7002DK"

# Anjay Settings
CONFIG_ANJAY_COMPAT_MBEDTLS=y
CONFIG_ANJAY_COMPAT_NET=y
CONFIG_ANJAY_COMPAT_TIME=y
CONFIG_ANJAY_LOG_LEVEL_INF=y
CONFIG_ANJAY_WITH_NET_STATS=n
CONFIG_ANJAY_WITH_SENML_JSON=y
CONFIG_ANJAY_WITH_TRACE_LOGS=n
CONFIG_ANJAY_WITH_ACCESS_CONTROL=n

# General Settings
CONFIG_MAIN_STACK_SIZE=2048
CONFIG_SYSTEM_WORKQUEUE_STACK_SIZE=4096
CONFIG_LOG_MAX_LEVEL=3
CONFIG_POSIX_MAX_FDS=16

# Networking
CONFIG_NET_NATIVE=y
CONFIG_NET_DHCPV4=y
CONFIG_DNS_RESOLVER=y
CONFIG_NET_MGMT=y
CONFIG_NET_MGMT_EVENT=y
CONFIG_NET_IPV6=n

# WiFi
CONFIG_WIFI=y
CONFIG_WIFI_NRF700X=y
CONFIG_WPA_SUPP=y
CONFIG_NET_L2_WIFI_MGMT=y
CONFIG_NET_L2_WIFI_MGMT_LOG_LEVEL_ERR=y
CONFIG_NET_L2_ETHERNET=y

# Clock synchronization
CONFIG_DATE_TIME=y
CONFIG_DATE_TIME_UPDATE_INTERVAL_SECONDS=600
CONFIG_DATE_TIME_TOO_OLD_SECONDS=600
CONFIG_DATE_TIME_NTP_QUERY_TIME_SECONDS=5

# File system
CONFIG_FLASH_PAGE_LAYOUT=y
CONFIG_MPU_ALLOW_FLASH_WRITE=y

# Heap
CONFIG_HEAP_MEM_POOL_SIZE=200000
```

## src/main.c
```c
/*
 * Copyright 2020-2025 AVSystem <avsystem@avsystem.com>
 *
 * Licensed under the Apache License, Version 2.0 (the "License");
 * you may not use this file except in compliance with the License.
 * You may obtain a copy of the License at
 *
 *     http://www.apache.org/licenses/LICENSE-2.0
 *
 * Unless required by applicable law or agreed to in writing, software
 * distributed under the License is distributed on an "AS IS" BASIS,
 * WITHOUT WARRANTIES OR CONDITIONS OF ANY KIND, either express or implied.
 * See the License for the specific language governing permissions and
 * limitations under the License.
 */

#include <stdlib.h>

#include <anjay_zephyr/config.h>
#include <anjay_zephyr/lwm2m.h>
#include <anjay_zephyr/objects.h>

int main(void)
{
	anjay_zephyr_lwm2m_init_from_settings();
	anjay_zephyr_lwm2m_start();

	// Anjay runs in a separate thread and preceding function doesn't block
	// add your own code here
	return 0;
}
```

## src/common.h
```c
/*
 * Copyright 2020-2021 AVSystem <avsystem@avsystem.com>
 *
 * Licensed under the Apache License, Version 2.0 (the "License");
 * you may not use this file except in compliance with the License.
 * You may obtain a copy of the License at
 *
 *     http://www.apache.org/licenses/LICENSE-2.0
 *
 * Unless required by applicable law or agreed to in writing, software
 * distributed under the License is distributed on an "AS IS" BASIS,
 * WITHOUT WARRANTIES OR CONDITIONS OF ANY KIND, either express or implied.
 * See the License for the specific language governing permissions and
 * limitations under the License.
 */

#ifndef ANJAY_ZEPHYR_COMMON

#define ANJAY_ZEPHYR_COMMON

#include <kernel.h>
#include <shell/shell.h>
#include <shell/shell_uart.h>
#include <stdlib.h>

extern struct k_mutex ANJAY_MTX;
extern volatile bool ANJAY_RUNNING;

#define SYNCHRONIZED(Mtx)                                          \
    for (int _synchronized_exit = k_mutex_lock(&(Mtx), K_FOREVER); \
         !_synchronized_exit; _synchronized_exit = -1, k_mutex_unlock(&(Mtx)))

#define ANJAY_THREAD_PRIO 1
#define ANJAY_THREAD_STACK_SIZE 8192

extern struct k_thread ANJAY_THREAD;

#define DEFAULT_LOG_LEVEL AVS_LOG_INFO

#endif // ANJAY_ZEPHYR_COMMON
```

## src/utils.c
```c
/*
 * Copyright 2020-2022 AVSystem <avsystem@avsystem.com>
 *
 * Licensed under the Apache License, Version 2.0 (the "License");
 * you may not use this file except in compliance with the License.
 * You may obtain a copy of the License at
 *
 *     http://www.apache.org/licenses/LICENSE-2.0
 *
 * Unless required by applicable law or agreed to in writing, software
 * distributed under the License is distributed on an "AS IS" BASIS,
 * WITHOUT WARRANTIES OR CONDITIONS OF ANY KIND, either express or implied.
 * See the License for the specific language governing permissions and
 * limitations under the License.
 */

#include "utils.h"

#include <string.h>

#include <zephyr/drivers/hwinfo.h>

#include <avsystem/commons/avs_utils.h>

#ifdef CONFIG_NET_IPV6
#include <zephyr/net/socketutils.h>
#endif // CONFIG_NET_IPV6

int get_device_id(struct device_id *out_id)
{
	memset(out_id->value, 0, sizeof(out_id->value));

	uint8_t id[12];
	ssize_t retval = hwinfo_get_device_id(id, sizeof(id));

	if (retval <= 0) {
		return -1;
	}

	return avs_hexlify(out_id->value, sizeof(out_id->value), NULL, id, (size_t)retval);
}

/*
 * Copyright (c) 2019 Linaro Limited
 *
 * SPDX-License-Identifier: Apache-2.0
 *
 * This sntp_simple_ipv6 function is a copy of sntp_simple function from Zephyr
 * (https://github.com/zephyrproject-rtos/zephyr/blob/zephyr-v3.0.0/subsys/net/lib/sntp/sntp_simple.c)
 * repository. The only change is the desired address family.
 */

#ifdef CONFIG_NET_IPV6
int sntp_simple_ipv6(const char *server, uint32_t timeout, struct sntp_time *time)
{
	int res;
	static struct addrinfo hints;
	struct addrinfo *addr;
	struct sntp_ctx sntp_ctx;
	uint64_t deadline;
	uint32_t iter_timeout;

	hints.ai_family = AF_INET6;
	hints.ai_socktype = SOCK_DGRAM;
	hints.ai_protocol = 0;
	/* 123 is the standard SNTP port per RFC4330 */
	res = net_getaddrinfo_addr_str(server, "123", &hints, &addr);

	if (res < 0) {
		/* Just in case, as namespace for getaddrinfo errors is
		 * different from errno errors.
		 */
		errno = EDOM;
		return res;
	}

	res = sntp_init(&sntp_ctx, addr->ai_addr, addr->ai_addrlen);
	if (res < 0) {
		goto freeaddr;
	}

	if (timeout == SYS_FOREVER_MS) {
		deadline = (uint64_t)timeout;
	} else {
		deadline = k_uptime_get() + (uint64_t)timeout;
	}

	/* Timeout for current iteration */
	iter_timeout = 100;

	while (k_uptime_get() < deadline) {
		res = sntp_query(&sntp_ctx, iter_timeout, time);

		if (res != -ETIMEDOUT) {
			break;
		}

		/* Exponential backoff with limit */
		if (iter_timeout < 1000) {
			iter_timeout *= 2;
		}
	}

	sntp_close(&sntp_ctx);

freeaddr:
	freeaddrinfo(addr);

	return res;
}
#endif // CONFIG_NET_IPV6
```

## src/utils.h
```c
/*
 * Copyright 2020-2022 AVSystem <avsystem@avsystem.com>
 *
 * Licensed under the Apache License, Version 2.0 (the "License");
 * you may not use this file except in compliance with the License.
 * You may obtain a copy of the License at
 *
 *     http://www.apache.org/licenses/LICENSE-2.0
 *
 * Unless required by applicable law or agreed to in writing, software
 * distributed under the License is distributed on an "AS IS" BASIS,
 * WITHOUT WARRANTIES OR CONDITIONS OF ANY KIND, either express or implied.
 * See the License for the specific language governing permissions and
 * limitations under the License.
 */

#pragma once

#include <stdint.h>

#ifdef CONFIG_NET_IPV6
#include <zephyr/net/sntp.h>
#endif // CONFIG_NET_IPV6

struct device_id {
	// 96 bits as hex + NULL-byte
	char value[25];
};

int get_device_id(struct device_id *out_id);
#ifdef CONFIG_NET_IPV6
int sntp_simple_ipv6(const char *server, uint32_t timeout, struct sntp_time *time);
#endif // CONFIG_NET_IPV6
```
